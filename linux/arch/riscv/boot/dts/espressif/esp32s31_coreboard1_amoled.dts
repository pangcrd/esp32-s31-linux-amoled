// SPDX-License-Identifier: GPL-2.0+
/* C05300AF-51: native 410x502, landscape framebuffer 502x410.
 * Software rotation maps logical X to GRAM rows 0..501 and logical Y
 * (reversed) to GRAM columns 22..431. MADCTL cannot exchange axes.
 * Keep supplier order and the working 40 MHz; disable TE during init.
 */
#include "esp32s31_coreboard1.dts"
#include <dt-bindings/dma/espressif,esp32s31-axi-gdma.h>

&axi_gdma {
	status = "okay";
};

&gpspi2 {
	dmas = <&axi_gdma ESP32S31_GDMA_TX0 ESP32S31_GDMA_SPI2>,
	       <&axi_gdma ESP32S31_GDMA_RX0 ESP32S31_GDMA_SPI2>;
	dma-names = "tx", "rx";
	espressif,gpio-cs-drive-strength = <20>;
	/delete-node/ spidev@0;

	panel@0 {
		compatible = "chipone,co5300";
		reg = <0>;
		spi-max-frequency = <40000000>;
		spi-tx-bus-width = <4>;
		reset-gpios = <&pinctrl 0 GPIO_ACTIVE_LOW>;
		chipone,width = <502>;
		chipone,height = <410>;
		chipone,x-offset = <0>;
		chipone,y-offset = <22>;
		/* Record format: [cmd, len, delay-ms BE16, data...].
		 * Explicit MADCTL=00h matches IDF: RGB order, native axes.
		 * TE-off is parameterless 34h; 35h=00h enables TE output.
		 */
		chipone,init-sequence = [36 01 00 00 00
					  fe 01 00 00 00 c4 01 00 00 80
					  3a 01 00 00 55
					  34 00 00 00 53 01 00 00 20
					  51 01 00 00 ff 63 01 00 00 ff
					  11 00 02 58];
	};
};
