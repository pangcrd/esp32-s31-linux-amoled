## br2-external/package/co5300-splash/Config.in
```kconfig
config BR2_PACKAGE_CO5300_SPLASH
	bool "CO5300 boot splash"
	help
	  One-shot RGB565 splash for the opt-in CO5300 framebuffer console.
	  Displays a centered image with a 40-pixel inset before getty starts.
```

## linux/Documentation/devicetree/bindings/display/chipone,co5300.yaml
```yaml
# SPDX-License-Identifier: (GPL-2.0-only OR BSD-2-Clause)
%YAML 1.2
---
$id: http://devicetree.org/schemas/display/chipone,co5300.yaml#
$schema: http://devicetree.org/meta-schemas/core.yaml#

title: Chipone CO5300 QSPI AMOLED panel

maintainers:
  - Espressif Linux Port Maintainers <linux-riscv@espressif.com>

description: |
  Local binding for the CO5300 framebuffer console. Command headers and
  command parameters use one SPI lane. Pixel data uses four lanes.
  Panel geometry and vendor initialization must match the actual module.

allOf:
  - $ref: /schemas/spi/spi-peripheral-props.yaml#

properties:
  compatible:
    const: chipone,co5300

  reg:
    maxItems: 1

  spi-max-frequency:
    maximum: 80000000

  spi-tx-bus-width:
    const: 4

  reset-gpios:
    maxItems: 1

  chipone,width:
    $ref: /schemas/types.yaml#/definitions/uint32
    description: Landscape framebuffer width; maps to native GRAM rows.
    minimum: 1
    maximum: 512
    default: 502

  chipone,height:
    $ref: /schemas/types.yaml#/definitions/uint32
    description: Landscape framebuffer height; maps to native GRAM columns.
    minimum: 1
    maximum: 512
    default: 410

  chipone,x-offset:
    $ref: /schemas/types.yaml#/definitions/uint32
    description: Offset of logical X in native GRAM rows.
    maximum: 65534
    default: 0

  chipone,y-offset:
    $ref: /schemas/types.yaml#/definitions/uint32
    description: Offset of reversed logical Y in native GRAM columns.
    maximum: 65534
    default: 22

  chipone,init-sequence:
    $ref: /schemas/types.yaml#/definitions/uint8-array
    minItems: 4
    maxItems: 4096
    description: |
      Optional supplier initialization replacing the reference sequence.
      Each record contains command, payload length, delay in milliseconds
      as two bytes (MSB first), and payload. The driver validates record
      boundaries. Display On (0x29) follows it. Include COLMOD 0x55,
      Sleep Out and its delay. Landscape rotation is done in software;
      CO5300 MADCTL does not provide row/column exchange.
      Geometry plus offsets must fit in 16-bit column/row addresses.

  rotation:
    $ref: /schemas/types.yaml#/definitions/uint32
    description: |
      Software rotation in degrees relative to the default landscape view.
      90/270 swap the framebuffer dimensions at probe time. Geometry and
      offsets above always describe the default landscape GRAM rectangle.
    enum: [0, 90, 180, 270]
    default: 0

required:
  - compatible
  - reg
  - spi-max-frequency
  - spi-tx-bus-width
  - reset-gpios

unevaluatedProperties: false
...
```

## linux/Documentation/devicetree/bindings/dma/espressif,esp32s31-axi-gdma.yaml
```yaml
# SPDX-License-Identifier: (GPL-2.0-only OR BSD-2-Clause)
%YAML 1.2
---
$id: http://devicetree.org/schemas/dma/espressif,esp32s31-axi-gdma.yaml#
$schema: http://devicetree.org/meta-schemas/core.yaml#

title: Espressif ESP32-S31 AXI GDMA controller

maintainers:
  - pangcrd <pangcrd@users.noreply.github.com>

description: |
  Three independent receive/transmit channel pairs on the AXI bus. Descriptor
  addresses are 8-byte aligned. The first DMA cell selects a directional
  channel (RX0=0, TX0=1, RX1=2, TX1=3, RX2=4, TX2=5). The second selects the
  peripheral (LCD/CAM=0, SPI2=1, SPI3=2, PARLIO=3, AES=4, SHA=5). One channel
  per direction may connect to a given peripheral. GPIO-CS ownership remains
  with the SPI controller and does not belong to this DMA controller.

allOf:
  - $ref: dma-controller.yaml#

properties:
  compatible:
    const: espressif,esp32s31-axi-gdma
  reg:
    maxItems: 1
  clocks:
    maxItems: 1
  resets:
    maxItems: 1
  interrupts:
    minItems: 6
    maxItems: 6
  interrupt-names:
    items:
      - const: rx0
      - const: tx0
      - const: rx1
      - const: tx1
      - const: rx2
      - const: tx2
  "#dma-cells":
    const: 2

required:
  - compatible
  - reg
  - clocks
  - resets
  - interrupts
  - interrupt-names
  - "#dma-cells"

unevaluatedProperties: false
...
```
